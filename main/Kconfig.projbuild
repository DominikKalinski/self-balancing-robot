## main/Kconfig.projbuild
```kconfig
menu "MPU6050 Example Configuration"

    choice EXAMPLE_I2C_ADDRESS
        prompt "Select I2C address"
        default EXAMPLE_I2C_ADDRESS_LOW
        help
            Select I2C address

        config EXAMPLE_I2C_ADDRESS_LOW
            bool "MPU6050_I2C_ADDRESS_LOW"
            help
                Choose this when ADDR pin is connected to ground
        config EXAMPLE_I2C_ADDRESS_HIGH
            bool "MPU6050_I2C_ADDRESS_HIGH"
            help
                Choose this when ADDR pin is connected to VCC
    endchoice

    config EXAMPLE_SCL_GPIO
        int "MPU6050 SCL GPIO Number"
        default 5 if IDF_TARGET_ESP8266
        default 4 if IDF_TARGET_ESP32C2 || IDF_TARGET_ESP32C3 || IDF_TARGET_ESP32C5 || IDF_TARGET_ESP32C6 || IDF_TARGET_ESP32C61
        default 4 if IDF_TARGET_ESP32H2
        default 4 if IDF_TARGET_ESP32P4
        default 19 if IDF_TARGET_ESP32 || IDF_TARGET_ESP32S2 || IDF_TARGET_ESP32S3
        help
            GPIO number for I2C Master clock line.

    config EXAMPLE_SDA_GPIO
        int "MPU6050 SDA GPIO Number"
        default 4 if IDF_TARGET_ESP8266
        default 5 if IDF_TARGET_ESP32C2 || IDF_TARGET_ESP32C3 || IDF_TARGET_ESP32C5 || IDF_TARGET_ESP32C6 || IDF_TARGET_ESP32C61
        default 5 if IDF_TARGET_ESP32H2
        default 5 if IDF_TARGET_ESP32P4
        default 18 if IDF_TARGET_ESP32 || IDF_TARGET_ESP32S2 || IDF_TARGET_ESP32S3
        help
            GPIO number for I2C Master data line.
     
endmenu

menu "Robot configuration"
    menu "Motor 1"
        config MOTOR1_PWM_GPIO
            int "PWM_GPIO"
            default 18

        config MOTOR1_DIR_GPIO
            int "DIR_GPIO"
            default 19

        config MOTOR1_ENCODER_A_YELLOW
            int "ENCODER_A_YELLOW"
            default 9

        config MOTOR1_ENCODER_B_WHITE
            int "ENCODER_B_WHITE"
            default 15
    endmenu

    menu "Motor 2"
           config MOTOR2_PWM_GPIO
            int "PWM_GPIO"
            default 7

        config MOTOR2_DIR_GPIO
            int "DIR_GPIO"
           default 6

        config MOTOR2_ENCODER_A_YELLOW
            int "ENCODER_A_YELLOW"
            default 22

        config MOTOR2_ENCODER_B_WHITE
            int "ENCODER_B_WHITE"
            default 23
    endmenu

    menu "Buzzer"
        config BUZZER_GPIO
            int"BUZZER_GPIO"
            default 8
    endmenu

    menu "Button"
        config BUTTON_GPIO
            int "BUTTON_GPIO"
            default 5
    endmenu

    menu "Voltage"
        config VOLTAGE_GPIO
            int"VOLTAGE_GPIO"
            default 4
    endmenu

endmenu
```
